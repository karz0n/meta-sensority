## conf/layer.conf
```bitbake
# We have a conf and classes directory, add to BBPATH
BBPATH .= ":${LAYERDIR}"

# We have recipes-* directories, add to BBFILES
BBFILES += "${LAYERDIR}/recipes-*/*/*.bb \
            ${LAYERDIR}/recipes-*/*/*.bbappend"

BBFILE_COLLECTIONS += "sensority"
BBFILE_PATTERN_sensority = "^${LAYERDIR}/"
BBFILE_PRIORITY_sensority = "6"

LAYERDEPENDS_sensority = "core"
LAYERSERIES_COMPAT_sensority = "hardknott"
```
